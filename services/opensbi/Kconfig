## services/opensbi/Kconfig
```kconfig
config SERVICE_OPENSBI
	def_bool y
	depends on OPENSBI
	help
        This feature enables support for OPENSBI.
                
		If you do not know what to do here, say Y.

config SERVICE_OPENSBI_IPC
	bool "OpenSBI IPC ecall support"
	default y
	depends on OPENSBI && USE_IHC_V2
	help
        This feature enables support for IPC ecall service compatible
		with the Mi-V IHC IP v2.

		If you do not know what to do here, say Y.

config SERVICE_OPENSBI_RPROC_IPC
	bool "Remote Proc ecall service support"
	default yd
	depends on SERVICE_OPENSBI_IPC
	help
        This feature enables support for the IPC RemoteProc ecall service
		compatible with the Mi-V IHC IP v2.
      
		If you do not know what to do here, say Y.

config SERVICE_OPENSBI_IHC
	bool "OpenSBI IHC legacy ecall support"
	default y
	depends on OPENSBI && USE_IHC
	help
        This feature enables support for IHC ecall service
		compatible with the legacy Mi-V IHC subsystem.
                
		If you do not know what to do here, say Y.

config SERVICE_OPENSBI_RPROC
	bool "Remote Proc legacy ecall service support"
	default y
	depends on SERVICE_OPENSBI_IHC
	help
        This feature enables support for RemoteProc ecall service
		compatible with the legacy Mi-V IHC subsystem.
                
		If you do not know what to do here, say Y.

config SERVICE_OPENSBI_CRYPTO
	bool "User Crypto ecall service support"
	default y
	depends on OPENSBI && USE_USER_CRYPTO
	help
	  This feature enables support for user crypto ecall service.

	  If you do not know what to do here, say Y.

config SERVICE_OPENSBI_SUSPEND_CLOCK_SCALING
	bool "Scale MSS clocks during system suspend"
	default n
	depends on SERVICE_OPENSBI
	help
	  This feature lowers CPU, AXI and AHB/APB clocks while Linux is
	  suspended, and retunes MMUART0 around the clock change.

	  If you do not know what to do here, say N.

config SERVICE_OPENSBI_SUSPEND_SCB_CLOCK_SWITCH
	bool "Switch MSS to the SCB clock during system suspend"
	default n
	depends on SERVICE_OPENSBI_SUSPEND_CLOCK_SCALING
	help
	  This feature switches clk_in_mss to the 80 MHz SCB standby clock
	  while Linux is suspended, then disables the MSS PLL Q0 output.

	  If you do not know what to do here, say N.

config SERVICE_OPENSBI_SUSPEND_DDR_POWER_SAVE
	bool "Enable DDR power saving during system suspend"
	default n
	depends on SERVICE_OPENSBI && !SKIP_DDR
	help
	  This feature enables the tested DDR suspend power sequence:
	  disable DRAM clocks through the DDR controller while in
	  self-refresh, put DDR logic in low power, gate DDR PLL outputs,
	  and gate the DDRC sub-block clock until resume.

	  If you do not know what to do here, say N.

config OPENSBI_SRC_DIR
	string
	option env="OPENSBI_SRC_DIR"

config FDT_IPI
	def_bool y

config FDT_IPI_MSWI
	def_bool y

config FDT_IPI_PLICSW
	def_bool y

config FDT_IRQCHIP
	def_bool y

config FDT_IRQCHIP_PLIC
	def_bool y

config FDT_RESET
	def_bool y

config FDT_SERIAL
	def_bool y

config FDT_SERIAL_UART8250
	def_bool y

config FDT_TIMER
	def_bool y

config FDT_TIMER_MTIMER
	def_bool y

# Override upstream defaults for features not needed on MPFS

config SBI_ECALL_CPPC
	def_bool n

config SBI_ECALL_MPXY
	def_bool n

config SBIUNIT
	def_bool n

config SBI_ECALL_DBCN
	def_bool y

config SBI_ECALL_SUSP
	def_bool y

config SBI_ECALL_FWFT
	def_bool y

config SBI_ECALL_CPPC
	def_bool n

config SBI_ECALL_SSE
	def_bool y

config SBI_ECALL_MPXY
	def_bool n

config SBIUNIT
	def_bool n

config CONSOLE_EARLY_BUFFER_SIZE
	def_int 256

config SBI_ECALL_DBTR
	def_bool y

source "$(OPENSBI_SRC_DIR)/lib/sbi/Kconfig"
```
