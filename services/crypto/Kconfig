## services/crypto/Kconfig
```kconfig
config SERVICE_CRYPTO
	bool "Cryptography support"
	default n
	help
                This feature enables support for crytographic signing of boot images.

		If you do not know what to do here, say Y.
```

## services/ddr/Kconfig
```kconfig
config SERVICE_DDR
	def_bool y
	help
                This feature enables support for the E51 to setup DDR.
```

## services/emmc/Kconfig
```kconfig
config SERVICE_EMMC
	bool "EMMC support"
	default n
	help
                This feature enables support for booting via EMMC.

		If you do not know what to do here, say Y.
```

## services/flashfreeze/Kconfig
```kconfig
config SERVICE_FLASHFREEZE
	bool "Flash*Freeze support*"
	default n
	help
                This feature enables support for Flash*Freeze.

		If you do not know what to do here, say Y.
```

## services/goto/Kconfig
```kconfig
config SERVICE_GOTO
	bool "GOTO support"
	default y
	help
                This feature enables support for the E51 to instruct a U54 application hart to 
                execute code in an aribtrary location of memory. 
```

## services/gpio_ui/Kconfig
```kconfig
config SERVICE_GPIO_UI
	bool "GPIO User Interface support"
	default n
	help
		This feature enables a simple user interface using GPIOs (LEDs and buttons).
                This is automatically disabled if SERVICE_TINYCLI is selected
          
		If you do not know what to do here, say N.
```

## services/healthmon/Kconfig
```kconfig
config SERVICE_HEALTHMON
	bool "Health Monitoring support"
	default n
	help
		This feature enables support for delegated Health Monitoring.

		If you do not know what to do here, say Y.
```

## services/ipi_poll/Kconfig
```kconfig
config SERVICE_IPI_POLL
	bool "IPI Polling support"
	default n
	help
                This feature enables support for IPI Polling.
                
		If you do not know what to do here, say Y.
```

## services/lockdown/Kconfig
```kconfig
config SERVICE_LOCKDOWN
	bool "Lockdown Service"
	default n
	help
                This feature enables support for E51 lockdown service.
                Once boot has completed, the E51 will go into a loop in 
                the lockdown service, where it sets up its own PMPs,
                and from then only services the watchdogs.
    
                This service provides an opportunity/single place in the
                code to modify behavior once boot has completed if the
                user wishes to prevent the E51/HSS from running further.

		If you do not know what to do here, say N.
```

## services/mmc/Kconfig
```kconfig
config SERVICE_MMC
	bool "MMC support"
	default y
	help
                This feature enables support for booting via MMC.

		If you do not know what to do here, say Y.

menu "MMC"
	visible if SERVICE_MMC

menu "MMC Mode"

config SERVICE_MMC_MODE_EMMC
	bool "Use eMMC"
	default y
        depends on SERVICE_MMC
	help
                This feature sets the MMC system to use eMMC.
                This option is mutually exclusive with SERVICE_MMC_MODE_SDCARD.

		If you do not know what to do here, say Y.

config SERVICE_MMC_MODE_SDCARD
	bool "Use SDCard"
	default y
        depends on SERVICE_MMC
	help
                This feature sets the MMC system to use SDCard.
                This option is mutually exclusive with SERVICE_MMC_MODE_EMMC.

		If you do not know what to do here, say N.

endmenu

menu "MMC Voltage"

config SERVICE_MMC_BUS_VOLTAGE_1V8
	bool "Use 1.8V Bus Voltage with MMC"
	default n
        depends on SERVICE_MMC
	help
                This feature sets the bus voltage for MMC to 1.8V.
                This option is mutually exclusive with SERVICE_MMC_BUS_VOLTAGE_3V3.

		If you do not know what to do here, say N.

config SERVICE_MMC_BUS_VOLTAGE_3V3
	bool "Use 3.3V Bus Voltage with MMC"
	default y
        depends on SERVICE_MMC && !SERVICE_MMC_BUS_VOLTAGE_1V8
	help
                This feature sets the bus voltage for MMC to 3.3V.
                This option is mutually exclusive with SERVICE_MMC_BUS_VOLTAGE_1V8..

		If you do not know what to do here, say Y.
endmenu

choice "MMC Speed"
	prompt "SD/eMMC Bus Speed"
	default SERVICE_MMC_HIGH_SPEED
	depends on SERVICE_MMC

config SERVICE_MMC_HIGH_SPEED
        bool "Use MMC High Speed (HS) Mode"

config SERVICE_MMC_DEFAULT_SPEED
        bool "Use MMC Default Speed (DS) Mode"

endchoice

menu "SDIO Control"

config SERVICE_MMC_FABRIC_SD_EMMC_DEMUX_SELECT_PRESENT
	bool "SDIO register present"
	default n
        depends on SERVICE_MMC_MODE_SDCARD || SERVICE_MMC_MODE_EMMC
	help
                This feature will enable the use of a register in the FPGA fabric for SDIO control.

		If this register is not present and this option is enabled the HSS will fail to boot.

config SERVICE_MMC_FABRIC_SD_EMMC_DEMUX_SELECT_ADDRESS
	hex "Memory mapped address of SDIO register"
	default 0x4f000000
	depends on SERVICE_MMC_FABRIC_SD_EMMC_DEMUX_SELECT_PRESENT
        help
                This value represents the memory mapped address of a register in the FPGA fabric.
                This register is used to select between eMMC and SD card when a de-mux is present on a board.
                
endmenu

config SERVICE_MMC_SPIN_TIMEOUT
	bool "Apply timeout to spins in MMC driver"
	default y
        depends on SERVICE_MMC_MODE_SDCARD || SERVICE_MMC_MODE_EMMC
	help
                This feature will enable maximum loop checks on spins in the MMC driver.

		If you do not know what to do here, say Y.

config SERVICE_MMC_SPIN_TIMEOUT_ASSERT
	bool "Assert if spin in MMC driver times out"
	default n
        depends on SERVICE_MMC_SPIN_TIMEOUT
	help
                This feature will enable an assert if maximum loop checks on spins in the MMC driver trigger.

		If you do not know what to do here, say N.

config SERVICE_MMC_SPIN_TIMEOUT_MAX_SPINS
	int "Configure maximum permissible number of spins in MMC driver"
        default 1000000
        depends on SERVICE_MMC_SPIN_TIMEOUT
        range 0 10000000
	help
                This value controls the max number of loop spins before trigger a timeout in the MMC driver.

endmenu
```

## services/powermode/Kconfig
```kconfig
config SERVICE_POWERMODE
	bool "Low Power Mode support"
	default n
	help
                This feature enables support for Low Power Mode operation.

		If you do not know what to do here, say Y.
```

## services/qspi/Kconfig
```kconfig
config SERVICE_QSPI
	bool "Boot from QSPI NAND flash support"
	default y
	help
                This feature enables support for booting via QSPI NAND Flash.
                Currently the Winbond W25N01GV is supported.

		If you do not know what to do here, say Y.

menu "QSPI"
	visible if SERVICE_QSPI

choice
	prompt "QSPI Driver"
	default SERVICE_QSPI_WINBOND_W25N01GV

config SERVICE_QSPI_WINBOND_W25N01GV
	bool "Winbond W25N01GV"
	depends on SERVICE_QSPI
	help
		This feature enables support for Winbond W25N01GV SPI NAND flash.

		If you don't know what to do here, say Y.

config SERVICE_QSPI_MICRON_MQ25T
	bool "Micron MQ25T"
	depends on SERVICE_QSPI
	help
		This feature enables support for Micron MQ25T SPI NOR flash.

		If you don't know what to do here, say N.

config SERVICE_QSPI_WINBOND_W25N01GV_FPGA
	bool "Winbond W25N01GV FPGA"
	depends on SERVICE_QSPI
	help
		This feature enables support for Winbond W25N01GV SPI NAND flash in FPGA.

		If you don't know what to do here, say N.

endchoice

endmenu
```

## services/scrub/Kconfig
```kconfig
config SERVICE_SCRUB
	bool "RAM Scrubbing support"
	default n
	help
	  This feature enables support for E51-delegated RAM Scrubbing.

	  This feature is incompatible with using non-coherent memory. It will
	  conflict with any Linux drivers using non-coherent DMA transfers for
	  speed on PolarFire SoC, such as PCIe, but may be of use in systems
	  where the working set will not guarantee sufficient flushing of the
          cache to prevent undetected singe-bit errors.

          To use this feature with Linux, make sure the Linux kernel is using
          fully coherent DMA transfers.

	  If you do not know what to do here, say N.

menu "RAM Scrubbing Service"
	visible if SERVICE_SCRUB

config SERVICE_SCRUB_MAX_SIZE_PER_LOOP_ITER
	int "Number of bytes per superloop iteration to scrub"
	default  4096
	depends on SERVICE_SCRUB
	help
	  This parameter determines how many bytes will be scrubbed per superloop.

config SERVICE_SCRUB_RUN_EVERY_X_SUPERLOOPS
	int "Throttle to run every X superloops"
	default  256
	depends on SERVICE_SCRUB
	help
	  This parameter throttles the scrubbing service to only run once every
	  specified number of superloop iterations.

config SERVICE_SCRUB_CACHES
	bool "Cache Scrubbing Support"
	default n
	help
	  This feature enables support for scrubbing caches. It scrubs the
	  I$ on E51 and U54s, and scrubs the TLBs on the U54s.

	  This feature is incompatible with using non-coherent memory. It will
	  conflict with any Linux drivers using non-coherent DMA transfers for
	  speed on PolarFire SoC, such as PCIe, but may be of use in systems
	  where the working set will not guarantee sufficient flushing of the
          cache to prevent undetected singe-bit errors.

	  If you do not know what to do here, say N.

config SERVICE_SCRUB_CACHES_TRIGGER_SETPOINT
	int "Throttle to run every X superloops"
	default 1000000
	depends on SERVICE_SCRUB_CACHES
	help
	  This parameter throttles the cache scrubbing service to only run once every
	  specified number of superloop iterations.

config SERVICE_SCRUB_L2LIM
	bool "L2 LIM Memory Scrubbing support"
	default y
	help
	  This feature enables support for scrubbing L2 LIM memory.

	  If you do not know what to do here, say Y.

config SERVICE_SCRUB_L2SCRATCH
	bool "L2 Scratch Memory Scrubbing support"
	default y
	help
	  This feature enables support for scrubbing L2 Scratch memory.

	  If you do not know what to do here, say Y.

config SERVICE_SCRUB_DTIM
	bool "E51 DTIM Scrubbing support"
	default y
	help
	  This feature enables support for scrubbing E51 DTIM.

	  If you do not know what to do here, say Y.

config SERVICE_SCRUB_CACHED_DDR
	bool "Cached RAM Scrubbing support"
	default n
	help
	  This feature enables support for Cached RAM. It will conflict
	  with any Linux drivers using non-coherent DMA transfers for speed
	  on PolarFire SoC, such as PCIe, but may be of use in systems
	  where the working set will not guarantee sufficient flushing of the
          cache to prevent undetected singe-bit errors.

	  If you do not know what to do here, say N.

config SERVICE_SCRUB_NONCACHED_DDR
	bool "Non-Cached RAM Scrubbing support"
	default n
	help
	  This feature enables support for Non-Cached RAM.

	  If you do not know what to do here, say N.
endmenu
```

## services/sgdma/Kconfig
```kconfig
config SERVICE_SGDMA
	bool "SGDMA support"
	default n
	help
                This feature enables support for E51-delegated Scatter-Gather DMA.

		If you do not know what to do here, say Y.
```

## services/spi/Kconfig
```kconfig
config SERVICE_SPI
	bool "Boot from System Controller SPI flash support"
	default n
	help
                This feature enables booting from a payload stored in the SPI flash connected to the PolarFire SoC System Controller.

		If you do not know what to do here, say Y.
```

## services/tinycli/Kconfig
```kconfig
config SERVICE_TINYCLI
	bool "TinyCLI support"
	default n
	help
		This feature enables a simple command-line interpreter prompt.
          
		If you do not know what to do here, say N.

menu "Tiny Command Line Interface" 
	visible if SERVICE_TINYCLI

config SERVICE_TINYCLI_TIMEOUT
        depends on SERVICE_TINYCLI
	int "Timeout for entering TinyCLI (in seconds)"
	default 5
        help
		The timeout for entering the TinyCLI (in seconds). When CONFIG_TINYCLI is enabled,
                the HSS will wait for a keypress for this timeout before continuing with its boot
                process.

                If a key press (other than ESC) is detected, the HSS will enter the TINYCLI mode,
                which allows interactive running of a small number of commands. Typing `HELP` at
                the TINYCLI prompt lists the supported commands.

config SERVICE_TINYCLI_REGISTER
        depends on SERVICE_TINYCLI
	bool "Register TinyCLI as a state machine"
	default n
	help
		This feature enables the TinyCLI command-line interpreter to be registered
		as a state machine, which makes it available at all times via the E51.

		If you select this, you will not be able to configure UART_SURRENDER, which
		allows the HSS to surrender use of MMUART0 post-boot.

		If you do not know what to do here, say N.

config SERVICE_TINYCLI_MONITOR
	depends on SERVICE_TINYCLI && SERVICE_TINYCLI_REGISTER
	bool "Enable periodic monitoring of memory"
	default n
	help
		This feature enables the creation of a number of monitor tasks which
                can be configured to dump the contents of blocks of memory to the E51 
                console periodically.

		If you do not know what to do here, say N.

config SERVICE_TINYCLI_ENABLE_PREBOOT_TIMEOUT
	bool "Apply timeout to TinyCLI prompt if entered before boot"
	default n
	help
		This feature will ensure that accidentally entering TinyCLI before boot-up
		permanently prevent booting.

		If you do not know what to do here, say N.

config SERVICE_TINYCLI_PREBOOT_TIMEOUT
	int "Timeout for TinyCLI prompt (in seconds)"
	default 3600
	depends on SERVICE_TINYCLI_ENABLE_PREBOOT_TIMEOUT
	range 0 10000000
	help
		This value controls the time in seconds that a pre-boot TinyCLI prompt
		can be idle before the device will reset.

endmenu
```

## services/uart/Kconfig
```kconfig
config SERVICE_UART
	bool "UART support"
	default n
	help
                This feature enables support for virtual UART.

		If you do not know what to do here, say Y.
```

## services/usbdmsc/Kconfig
```kconfig
config SERVICE_USBDMSC
	bool "USBD-MSC support"
	default n
        depends on SERVICE_TINYCLI && (SERVICE_MMC || SERVICE_QSPI)
	help
		This feature enables USBD-MSC support to expose eMMC/SDCard over USB.
          
		If you do not know what to do here, say N.

menu "USB Device Mass Storage Class"
	visible if SERVICE_USBDMSC

config SERVICE_USBDMSC_ENABLE_MAX_SESSION_TIMEOUT
	bool "Apply timeout to USBDMSC"
	default n
	help
		This feature will ensure that accidentally leaving USBDMSC running
		too long will cause it to disconnect.

		If you do not know what to do here, say N.

config SERVICE_USBDMSC_MAX_SESSION_TIMEOUT
	int "Timeout for USBDMSC prompt (in seconds)"
        default 3600
        depends on SERVICE_USBDMSC_ENABLE_MAX_SESSION_TIMEOUT
        range 0 10000000
	help
		This value controls the maximum time in seconds that USBDMSC is
		allowed to run before it auto-disconnects.

endmenu
```

## services/wdog/Kconfig
```kconfig
config SERVICE_WDOG
	bool "Virtual Watchdog support"
	default y
	help
                This feature enables support for E51-delegated virtual watchdog monitoring of the
                U54 application harts.

		If you do not know what to do here, say Y.

menu "Watchdog Service"
	visible if SERVICE_WDOG

config SERVICE_WDOG_DEBUG
	bool "Virtual Watchdog Debug Messages"
	default n
	depends on SERVICE_WDOG
	help
		This feature enabled support for debug messages from the virtual watchdog service.

		If you do not know what to do here, say N.

config SERVICE_WDOG_DEBUG_TIMEOUT_SEC
	int "Time delay for debug output (seconds)"
	default 240
	depends on SERVICE_WDOG
	help
		This feature determines the maximum number of queue messages
		supported for IPIs from different harts.

config SERVICE_WDOG_ENABLE_E51
	bool "Enable watchdog on E51"
	default y
	depends on SERVICE_WDOG
	help
		This feature enables the watchdog for the E51 Hart. This will cause the entire Hart
		Coreplex to restart if, for some reason, the E51 becomes unable to periodically update
		its watchdog.

endmenu
```
