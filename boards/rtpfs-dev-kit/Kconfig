## boards/rtpfs-dev-kit/Kconfig
```kconfig
menu "MPFS RT-PolarFire SoC Board Configuration Options"

config SOC_FPGA_DESIGN_XML
	string "Enter path to Libero XML file"
	default "boards/$(BOARD)/soc_fpga_design/xml/mpfs_rtpfs_design_cfg.xml"
	help
		This option specifies the design XML file to use.
endmenu
```
