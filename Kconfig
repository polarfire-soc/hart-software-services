## boards/mpfs-navc/Kconfig
```kconfig
menu "NAVC Design Configuration Options"

config SOC_FPGA_DESIGN_XML
	string "Enter path to Libero XML file"
	default "boards/$(BOARD)/soc_fpga_design/xml/NAVC_MSS_mss_cfg.xml"
	help
		This option specifies the design XML file to use.

config DEFAULT_DEVICE_TREE
	string "boards/$(BOARD)/mpfs_minimal_uboot.dtb"
	depends on PROVIDE_DTB
	help
		This option specifies the default Device Tree to be used.

endmenu
```

## boards/mpfs-video-kit/Kconfig
```kconfig
menu "mpfs-video-kit Configuration Options"

config SOC_FPGA_DESIGN_XML
	string "Enter path to Libero XML file"
	default "boards/$(BOARD)/soc_fpga_design/xml/MSS_Video_kit_linux_mss_cfg.xml"
	help
		This option specifies the design XML file to use.
endmenu
```

## boards/no_som1soc/Kconfig
```kconfig
menu "Custom Board Design Configuration Options"

config SOC_FPGA_DESIGN_XML
	string "Enter path to Libero XML file"
	default "boards/no_som1soc/soc_fpga_design/xml/no_som1soc.xml"
	help
		This option specifies the design XML file to use.
endmenu
```

## boards/polarberry/Kconfig
```kconfig
menu "Polarberry Design Configuration Options"

config SOC_FPGA_DESIGN_XML
	string "Enter path to Libero XML file"
	default "boards/$(BOARD)/soc_fpga_design/xml/polarberry.xml"
	help
		This option specifies the design XML file to use.
endmenu
```

## compression/Kconfig
```kconfig
config COMPRESSION
	bool "Compression support"
        depends on SERVICE_BOOT
	default y
	help
		This feature enables support for compression of boot images

		If you don't know what to do here, say Y.

menu "Compression"

config COMPRESSION_FASTLZ
	def_bool y
	depends on COMPRESSION 
	help
		This feature enables support for FastLZ compression, a fast lossless compression 
                library.
endmenu
```

## debug/Kconfig
```kconfig
menu "Debug Options"

config DEBUG_LOG_STATE_TRANSITIONS
	bool "Debug State Transitions"
	default y
	help
		This feature enables debug output for all state machine transitions.

		If you do not know what to do here, say Y.

config DEBUG_LOOP_TIMES
	bool "Debug Loop Times"
	default y
	help
		This feature enables output for loop timings via debug UART 
                (mmuart0).

		If you do not know what to do here, say Y.

config DEBUG_LOOP_TIMES_THRESHOLD
	int "Output loop times every threshold cycles"
        default 2500000
        depends on DEBUG_LOOP_TIMES
	help
		If CONFIG_DEBUG_LOOP_TIMES is enabled, specify how often
                (in loop cycles) loop timings diagnostics should be dumped
                out via the debug UART.

config DEBUG_IPI_STATS
        bool "Debug IPI Statistics"
        default n
        help
		This feature enables output for IPI statistics via debug UART 

		If you do not know what to do here, say N.

config DEBUG_CHUNK_DOWNLOADS
        bool "Debug chunk downloads"
        depends on SERVICE_BOOT
        default n
        help
		This feature enables logging of each chunk copy.

		If you do not know what to do here, say N.

config DEBUG_MSCGEN_IPI
        bool "Output mscgen compatible traces of IPI messages"
        depends on SERVICE_BOOT
        default n
        help
		This feature enables logging of IPIs in a format to help
                generate mscgen traces.

		If you do not know what to do here, say N.

config DEBUG_PROFILING_SUPPORT
        bool "Output periodic function timings"
        depends on DEBUG_LOOP_TIMES
        default n
        help
		This feature enables periodic output of function timings.

		If you do not know what to do here, say N.

config DEBUG_PROFILING_MAX_NUM_FUNCTIONS
        int "Determine the maximum number of functions to track"
	default 128
        depends on DEBUG_PROFILING_SUPPORT
        help
		This feature configures how many fucntions to trace during profiling.

		If you do not know what to do here, say N.

endmenu
```

## modules/Kconfig
```kconfig
source "modules/compression/Kconfig"
source "modules/crypto/Kconfig"
source "modules/debug/Kconfig"
source "modules/ssmb/Kconfig"
```

## modules/compression/Kconfig
```kconfig
menu "Compression"
config COMPRESSION
	bool "Compression support"
        depends on SERVICE_BOOT
	default y
	help
		This feature enables support for compression of boot images

		If you don't know what to do here, say Y.

config COMPRESSION_MINIZ
	bool "miniz (DEFLATE)"
	depends on COMPRESSION
	default y
	help
		This feature enables support for miniz compression, a fast lossless compression
                library implementing DEFLATE.
endmenu
```

## modules/crypto/Kconfig
```kconfig
menu "Crypto"

config CRYPTO_SIGNING
	bool "Cryptographic Signing support"
        depends on SERVICE_BOOT
	default y
	help
		This feature enables support for signing of boot images

		If you don't know what to do here, say Y.

menu "Signing Configuration"
        visible if CRYPTO_SIGNING

config CRYPTO_SIGNING_KEY_PUBLIC
        depends on CRYPTO_SIGNING
	string "Enter path to X.509 DER Public Key"
	help
		This option specifies the ECC SECP384R1 public key (DER binary format) to use.
choice
	prompt "Crypto Library"
	default CRYPTO_LIBECC

config CRYPTO_LIBECC
	bool "libecc (SHA2 and ECDSA P-384)"
	depends on CRYPTO_SIGNING
	help
		This feature enables support for the libecc library for SHA2 hashing
                and ECDSA P-384 code signing.

config CRYPTO_USER_CRYPTO
	bool "User Crypto (SHA2 and ECDSA P-384)"
	depends on CRYPTO_SIGNING
	help
		This feature enables support for the UserCrypto core for SHA384 hashing
                and ECDSA P-384 code signing.
endchoice

choice
	prompt "Hash"
	default CRYPTO_SHA384

config CRYPTO_SHA384
	bool "SHA384"
	depends on CRYPTO_SIGNING
	help
		This feature enables SHA384 as the Hash Function for code signing.

endchoice

endmenu
endmenu
```

## modules/debug/Kconfig
```kconfig
menu "Debug Options"

config DEBUG_LOG_STATE_TRANSITIONS
	bool "Debug State Transitions"
	default y
	help
		This feature enables debug output for all state machine transitions.

		If you do not know what to do here, say Y.

config DEBUG_LOOP_TIMES
	bool "Debug Loop Times"
	default y
	help
		This feature enables output for loop timings via debug UART 
                (mmuart0).

		If you do not know what to do here, say Y.

config DEBUG_LOOP_TIMES_THRESHOLD
	int "Output loop times every threshold cycles"
        default 2500000
        depends on DEBUG_LOOP_TIMES
	help
		If CONFIG_DEBUG_LOOP_TIMES is enabled, specify how often
                (in loop cycles) loop timings diagnostics should be dumped
                out via the debug UART.

config DEBUG_IPI_STATS
        bool "Debug IPI Statistics"
        default n
        help
		This feature enables output for IPI statistics via debug UART 

		If you do not know what to do here, say N.

config DEBUG_CHUNK_DOWNLOADS
        bool "Debug chunk downloads"
        depends on SERVICE_BOOT
        default n
        help
		This feature enables logging of each chunk copy.

		If you do not know what to do here, say N.

config DEBUG_MSCGEN_IPI
        bool "Output mscgen compatible traces of IPI messages"
        depends on SERVICE_BOOT
        default n
        help
		This feature enables logging of IPIs in a format to help
                generate mscgen traces.

		If you do not know what to do here, say N.

config DEBUG_PROFILING_SUPPORT
        bool "Output periodic function timings"
        depends on DEBUG_LOOP_TIMES
        default n
        help
		This feature enables periodic output of function timings.

		If you do not know what to do here, say N.

config DEBUG_PROFILING_MAX_NUM_FUNCTIONS
        int "Determine the maximum number of functions to track"
	default 128
        depends on DEBUG_PROFILING_SUPPORT
        help
		This feature configures how many functions to trace during profiling.

config DEBUG_PERF_CTRS
	bool "Performance Counters"
	depends on SERVICE_TINYCLI
	default N
	help
		This feature enables performance counters to track wallclock time
		spent in various activities, such as DDR training, memory tests,
		MMC init, boot, etc.

		If you do not know what to do here, say N.

config DEBUG_PERF_CTRS_NUM
	int "Determine how many performance counters are enabled"
	default 16
	depends on DEBUG_PERF_CTRS
	help
		This feature configures how many performance counters are enabled.

endmenu
```

## modules/ssmb/Kconfig
```kconfig
menu "SSMB Options"

config HSS_USE_IHC
	bool "IHC Support"
	default y
	depends on USE_IHC
	help
		This feature enables support for signalling to the E51 monitor
		core via IHC. The alternative is to use a shared memory buffer
		and IPIs for signalling.

		If you don't know what to do here, say Y.

config IPI_MAX_NUM_QUEUE_MESSAGES
	int "Maximum number of outstanding IPI queue messages"
	default 128
	help
		This feature determines the maximum number of queue messages
		supported for IPIs from different harts.

config IPI_FIXED_BASE
	bool "Fix IPI Base address"
	default n
        help
		Use a fixed base address for the IPI-based Secure Signalling Message Bus.

		If you don't know what to do here, say N.

config IPI_BASE_ADDR
	hex "Base address for IPI Queueus"
	default 0xC0000000
	depends on IPI_FIXED_BASE
        help
		Specify the fixed base address for the IPI-based Secure Signalling Message Bus.

endmenu
```

## services/Kconfig
```kconfig
menu "Services"

source "services/beu/Kconfig"
source "services/boot/Kconfig"
source "services/crypto/Kconfig"
source "services/ddr/Kconfig"
source "services/flashfreeze/Kconfig"
source "services/goto/Kconfig"
source "services/ipi_poll/Kconfig"
source "services/mmc/Kconfig"
source "services/opensbi/Kconfig"
source "services/powermode/Kconfig"
source "services/qspi/Kconfig"
source "services/scrub/Kconfig"
source "services/sgdma/Kconfig"
source "services/spi/Kconfig"
source "services/tinycli/Kconfig"
source "services/uart/Kconfig"
source "services/usbdmsc/Kconfig"
source "services/wdog/Kconfig"
source "services/ymodem/Kconfig"

endmenu
```

## services/beu/Kconfig
```kconfig
config SERVICE_BEU
	bool "Bus Error Unit support"
	default n
	help
                This feature enables support for E51-delegated Bus Error Unit monitoring.

		If you do not know what to do here, say Y.
```

## services/boot/Kconfig
```kconfig
config SERVICE_BOOT
	bool "Enable booting"
	default y
	select SERVICE_OPENSBI
        select SERVICE_DDR
	help
                This feature enables support for bootstrapping the U54 application harts. This
                is enabled by default.

menu "Boot Service"
    visible if SERVICE_BOOT

config SERVICE_BOOT_SPI_FLASH_OFFSET
    hex "Copy payload from SPI FLASH at offset"
    default  0x400
    depends on SERVICE_SPI
    help
                This feature specifies the offset in SPI Flash where a boot image is stored.

config SERVICE_BOOT_USE_PAYLOAD
    bool "Use Payload Boot"
    default  n
    depends on SERVICE_BOOT
    help
                This feature enables booting a directly contained payload.

config SERVICE_BOOT_USE_PAYLOAD_IN_FABRIC
    bool "Use Payload in Fabric"
    default  n
    depends on SERVICE_BOOT_USE_PAYLOAD
    help
            This feature enables booting a payload contained in the fabric.

config SERVICE_BOOT_USE_PAYLOAD_IN_FABRIC_ADDRESS
    hex "Payload Fabric Address"
    default  0x400
    depends on SERVICE_BOOT_USE_PAYLOAD_IN_FABRIC
    help
            This feature specifies the address for a payload contained in the fabric.

config SERVICE_BOOT_CUSTOM_FLOW
    bool "Use Custom Boot Flow"
    default  n
    depends on SERVICE_BOOT
    help
                This feature enables custom booting flow where all HARTs
                will jump to same entry point in M-mode.

config SERVICE_BOOT_DDR_TARGET_ADDR
	hex "Target Base address for BOOT to DDR copy"
	default 0x103FC00000
	depends on SERVICE_BOOT
	help
                This feature specifies a scratch address for EMMC/QSPI decompression

config SERVICE_BOOT_MMC_USE_GPT
    bool "Use GPT with MMC"
    default SERVICE_BOOT && SERVICE_MMC && y
	depends on SERVICE_MMC
	help
		If CONFIG_SERVICE_MMC is enabled, then for MMC boots this option enables
                parsing of a GUID Partition Table (GPT) in search of the boot image starting
                sector..

config SERVICE_BOOT_SNVM
    bool "Boot from sNVM"
    default n
    depends on SERVICE_BOOT
    help
                This feature enables reading an HSS payload from Secure NVM (sNVM)
                pages at boot time. The payload is assembled from sequential sNVM
                pages into an L2-LIM staging area, then processed by the standard
                HSS boot service. Each sNVM page holds 252 bytes (non-authenticated).

config SERVICE_BOOT_SNVM_START_PAGE
    int "sNVM start page"
    default 0
    depends on SERVICE_BOOT_SNVM
    help
                First sNVM page (module index) where the HSS payload is stored.
                Valid range: 0-220.

config SERVICE_BOOT_SNVM_PAGE_COUNT
    int "sNVM page count"
    default 221
    depends on SERVICE_BOOT_SNVM
    help
                Number of sNVM pages to read. Maximum 221 pages (55,692 bytes
                at 252 bytes per page for non-authenticated format).

config SERVICE_BOOT_SNVM_STAGING_ADDR
    hex "L2-LIM staging address for sNVM payload"
    default 0x08100000
    depends on SERVICE_BOOT_SNVM
    help
                Address in L2-LIM where sNVM pages are assembled into a
                contiguous HSS payload image before boot processing.
                Must not overlap with HSS resident area or wolfBoot target.

config SERVICE_BOOT_SNVM_MAX_SIZE
    hex "Maximum sNVM payload size (bytes)"
    default 0xE000
    depends on SERVICE_BOOT_SNVM
    help
                Maximum size of sNVM payload. Used as YMODEM receive buffer
                size when DDR is disabled. 221 pages * 252 bytes = 55,692
                bytes. Default 0xE000 (57,344 bytes) provides headroom.

endmenu
```
