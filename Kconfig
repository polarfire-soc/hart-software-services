## Kconfig
```kconfig
mainmenu "Hart Software Services (HSS) Configuration"

source "boards/Kconfig"
source "services/Kconfig"
source "application/Kconfig.general"
source "application/Kconfig.build"
source "modules/Kconfig"
```

## Kconfig.build
```kconfig
mainmenu "Build Options"

menu "Build Options"

config COLOR_OUTPUT
        bool "Color log output"
        default y
        help
		This feature enables color for HSS output

		If you do not know what to do here, say Y.

config USE_LOGO
        bool "Display Logo"
        default y
        help
		This feature enables output for the Microchip logo.

		If you do not know what to do here, say Y.


config CC_STACKPROTECTOR_STRONG
	bool "Enable strong stack protection"
	default y
	help
		This feature enables strong stack checking on all function calls.

		If you don't know what to do here, say Y.

config CC_DUMP_STACKSIZE
	bool "Dump stack sizes"
	default n
	help
		This feature dumps information about the stack sizes

		If you don't know what to do here, say N.

config USE_MAKEDEP
	bool "Enable make dependencies in build system"
	default y
	help
		This feature enables automatic dependencies in the Makefile. This will create *.d
                files - one for each source file - which contain the analysed dependencies for the
                source.  This improves source dependency checking during builds.

		If you don't know what to do here, say Y.

config USE_GNU_BUILD_ID
	bool "Enable GNU Build ID in image"
	default y
	help
		This feature enables the generation of a GNU Build ID in binaries.

		If you don't know what to do here, say Y.

config HAS_INTTYPES
	bool "Use inttypes.h"
	default y
	help
		This features uses the inttypes.h header file from the toolchain. 

		If the toolchain does not provide inttypes.h, say N here.

endmenu
```

## Kconfig.general
```kconfig
menu "General Configuration Options"
config OPENSBI
	bool "OpenSBI support"
	default y
	help
		This feature enables support for the RISC-V OpenSBI.

		If you don't know what to do here, say Y.

config TINYCLI
	bool "TinyCLI support"
	default n
	help
		This feature enables a simple command-line interpreter prompt.
          
		If you don't know what to do here, say N.

config TINYCLI_TIMEOUT
        depends on TINYCLI
	int "MSS AXI Switch Clock"
	default 5
        help
		The timeout for entering the TinyCLI (in seconds). When CONFIG_TINYCLI is enabled,
                the HSS will wait for a keypress for this timeout before continuing with its boot
                process.

                If a key press (other than ESC) is detected, the HSS will enter the TINYCLI mode,
                which allows interactive running of a small number of commands. Typing `HELP` at
                the TINYCLI prompt lists the supported commands.

config SUPERLOOP_IN_U_MODE
	bool "Run Superloop in U-Mode"
	default n
	help
		Experimental: This feature runs the HSS superloop in U-Mode.

		If you don't know what to do here, say N for now.

config MEMTEST
	bool "DDR Memory Tester"
	default n
	help
		This feature enables a simple walking 1's style memory tester for the DDR.
          
		If you don't know what to do here, say N.

config IPI_MAX_NUM_QUEUE_MESSAGES
	int "Maximum number of outstanding IPI queue messages"
	default 128
	help
		This feature determines the maximum number of queue messages
		supported for IPIs from different harts.

config IPI_FIXED_BASE
	bool "Fix IPI Base address"
	default y
        help
		Use a fixed base address for the IPI-based Secure Signalling Message Bus.

config IPI_BASE_ADDR
	hex "Base address for IPI Queueus"
	default 0xC0000000
	depends on IPI_FIXED_BASE
        help
		Specify the fixed base address for the IPI-based Secure Signalling Message Bus.

config USE_PDMA
	bool "Use PDMA for memory-to-memory transfers"
	default y
        help
		Use the PDMA for memory to memory transfers.
endmenu
```

## application/Kconfig.build
```kconfig
mainmenu "Build Options"

menu "Build Options"

config COLOR_OUTPUT
        bool "Color log output"
        default y
        help
		This feature enables color for HSS output

		If you do not know what to do here, say Y.

config USE_LOGO
        bool "Display Logo"
        default y
        help
		This feature enables output for the Microchip logo.

		If you do not know what to do here, say Y.

menu "Logo"
config LOGO_INVERT_COLORS
	bool "Invert Logo colors"
        default n
        depends on USE_LOGO
        help
		This feature enables output for the Microchip logo, with
                white text.

		If you do not know what to do here, say N.
endmenu


config CC_STACKPROTECTOR_STRONG
	bool "Enable strong stack protection"
	default y
	help
		This feature enables strong stack checking on all function calls.

		If you do not know what to do here, say Y.

config CC_DUMP_STACKSIZE
	bool "Dump stack sizes"
	default n
	help
		This feature dumps information about the stack sizes

		If you do not know what to do here, say N.

config LD_RELAX
	bool "Use RISC-V Relaxing and the Global Pointer, GP"
	default n
        help
		The GP (Global Pointer) register optimises memory accesses within a single 4KB region.
		This size is 4K because RISC-V immediate values ar 12-bit signed values (+/- 2048)
		
		The linker uses the __global_pointer$ symbol definition to compare memory addresses
		and, if within range, it replaces absolute/pc-relative addressing with gp-relative
		addressing.
       		
		This can lead to smaller code size, but it does impose requirements on subsequent
		firmwares that they save/restore the GP.
		  
		If you do not know what to do here, say N.

config CC_USE_MAKEDEP
	bool "Enable make dependencies in build system"
	default y
	help
		This feature enables automatic dependencies in the Makefile. This will create *.d
                files - one for each source file - which contain the analysed dependencies for the
                source.  This improves source dependency checking during builds.

		If you do not know what to do here, say Y.

config CC_USE_GNU_BUILD_ID
	bool "Enable GNU Build ID in image"
	default y
	help
		This feature enables the generation of a GNU Build ID in binaries.

		If you do not know what to do here, say Y.

config CC_HAS_INTTYPES
	bool "Use inttypes.h"
	default y
	help
		This features uses the inttypes.h header file from the toolchain. 

		If the toolchain does not provide inttypes.h, say N here.

config DISPLAY_TOOL_VERSIONS
	bool "Display Compiler and Linker tool version information at startup."
	default y
	help
		This features displays compiler and linker tool version information at startup.

		If you do not know what to do here, say Y.

endmenu
```

## application/Kconfig.general
```kconfig
menu "General Configuration Options"

menu "Miscellaneous"
config USE_PCIE
	bool "Setup PCIe"
	default y
	help
		Setup the PCIe prior to application load

		If you don't know what to do here, say Y.

config UART_SURRENDER
	bool "HSS UART Surrender"
	depends on OPENSBI && !SERVICE_TINYCLI_REGISTER
        default n
	help
		If enabled, this feature "surrenders" MMUART0 after boot.  After this point,
		HSS status messages will no longer be sent out MMUART0

		This feature is not compatible with SERVICE_TINYCLI_REGISTER. If you want the
		HSS to surrender MMUART0 UART after boot, do not enable SERVICE_TINYCLI_REGISTER.

		If you do not know what to do here, say N.

config OPENSBI
	def_bool y
	help
		This feature enables support for the RISC-V OpenSBI.

		If you don't know what to do here, say Y.

config USE_IHC
	bool "Use MiV Inter-hart Communication"
	default y
	help
		Enable MiV Inter-Hart Communication (IHC)

menu "Tamper"

config USE_TAMPER
	bool "Setup tamper module"
	default n
	help
		Configure the tamper module on start up to clear and disable
		interrupts

		If you don't know what to do here, say N.

config TAMPER_BASE_ADDRESS
	depends on USE_TAMPER
	hex "Base address of the tamper module"
	default 0x40000500
	help
		This is the base address of the tamper macro. The address is
		determined by the implementation, and may vary between FPGA
		designs.

		The default represents that used in the Icicle Kit Reference
		Design as of the v2023.02 release.

endmenu

config ALLOW_COLDREBOOT
	bool "Allow contexts to issue a cold reboot"
	default y
	help
		If enabled, this feature globally allows a context to issue a
		cold reboot ecall.

		If disabled, only warm reboots will be permitted.

		In addition to enabling this option, the permission to issue a cold
		reboot must be granted to a context via the payload generator YAML file.

		If you do not know what to do here, say Y.

menu "Cold Reboot"
	visible if ALLOW_COLDREBOOT

config ALLOW_COLDREBOOT_ALWAYS
	bool "Always allow contexts to issue a cold reboot"
	default y
	depends on ALLOW_COLDREBOOT
	help
		If enabled, this feature globally allows all contexts to issue a
		cold reboot ecall, irrespective of payload.bin flag entitlements.

		If you do not know what to do here, say Y.

config COLDREBOOT_FULL_FPGA_RESET
	bool "Reset the FPGA when cold reboot is requested"
	default n
	depends on ALLOW_COLDREBOOT
	depends on USE_TAMPER
	help
		If enabled, this feature allows the HSS to do a full reset of
		the FPGA when a cold reboot is requested. This is required to
		initiate an Auto-Update at runtime but should be disabled
		otherwise. Ensure the "TAMPER_BASE_ADDRESS" is set to match
		the address of the tamper macro in your FPGA design.

		If you do not know what to do here, say N.

config ALLOW_COLDREBOOT_ON_OPENSBI_FAULT
	bool "Trigger a cold reboot on OpenSBI fault"
	default n
	depends on ALLOW_COLDREBOOT
	help
		If enabled, this feature globally allows all contexts to issue a
		cold reboot on encountering an OpenSBI fault condition.

		If you do not know what to do here, say N.

config COLDREBOOT_ON_OPENSBI_FAULT_DELAY
	int "Cold reboot on OpenSBI fault delay (in seconds)"
        default 5
        depends on ALLOW_COLDREBOOT_ON_OPENSBI_FAULT
        range 0 3600
	help
                if ALLOW_COLDREBOOT_ON_OPENSBI_FAULT is enabled, this value determines
                the time in seconds that a U54 ending the OpenSBI fault state before
                triggering a cold reboot.
endmenu

endmenu

menu "OpenSBI"
	visible if OPENSBI

config PROVIDE_DTB
	bool "Provide a DTB for OpenSBI"
	depends on OPENSBI
	default n
	help
		This feature enabling the building in of a device tree blob and the provision
		of this blob to OpenSBI via the a1 register.

                If this isn't needed, it is possible to save some space by removing it.

		If you don't know what to do here, say Y.

config DEFAULT_DEVICE_TREE
	string "hifive-unleashed-a00-freedom-u540.dtb"
	depends on PROVIDE_DTB
	help
		This option specifies the default Device Tree to be used.
endmenu

menu "Memory Options"
config SKIP_DDR
	bool "Skip DDR Training"
	default n
	help
		This feature enables skipping DDR training for systems without DDR.

		If you don't know what to do here, say N.

config MEMTEST
	bool "DDR Memory Tester"
	depends on !SKIP_DDR
	default n
	help
		This feature enables a simple walking 1's style memory tester for the DDR.

		If you don't know what to do here, say N.

config USE_PDMA
	bool "Use PDMA for memory-to-memory transfers"
	default y
        help
		Use the PDMA for memory to memory transfers.

config INITIALIZE_MEMORIES
	bool "Initialize memories to zero"
	default y
        help
		Initialize memories to zero, to seed ECC.
		
		If you don't know what to do here, say N for now.
endmenu

endmenu
```

## boards/Kconfig
```kconfig
menu "Board/Design Configuration Options"

config BOARD
	string
	option env="BOARD"

source "boards/$(BOARD)/Kconfig"
endmenu
```

## boards/aries-m100pfsevp/Kconfig
```kconfig
menu "aries-m100pfsevp Design Configuration Options"

config SOC_FPGA_DESIGN_XML
	string "Enter path to Libero XML file"
	default "boards/$(BOARD)/soc_fpga_design/xml/m100pfs_reference.xml"
	help
		This option specifies the design XML file to use.
endmenu
```

## boards/custom-board-design/Kconfig
```kconfig
menu "Design Configuration Options"

config SOC_FPGA_DESIGN_XML
	string "Enter path to Libero XML file"
	default "boards/$(BOARD)/soc_fpga_design/xml/design_cfg.xml"
	help
		This option specifies the design XML file to use.
endmenu
```

## boards/mpfs-disco-kit/Kconfig
```kconfig
menu "MPFS Discovery (Disco) Kit Design Configuration Options"

config SOC_FPGA_DESIGN_XML
	string "Enter path to Libero XML file"
	default "boards/$(BOARD)/soc_fpga_design/xml/MPFS_DISCOVERY_KIT_MSS_mss_cfg.xml"
	help
		This option specifies the design XML file to use.
endmenu
```

## boards/mpfs-icicle-kit-es/Kconfig
```kconfig
menu "Icicle-Kit Design Configuration Options"

config SOC_FPGA_DESIGN_XML
	string "Enter path to Libero XML file"
	default "boards/$(BOARD)/soc_fpga_design/xml/ICICLE_MSS_mss_cfg.xml"
	help
		This option specifies the design XML file to use.
endmenu
```

## boards/mpfs-icicle-kit-es/bni-delta_defconfig
```kconfig
#
# Services
#
CONFIG_SERVICE_BOOT=y

#
# Boot Service
#
CONFIG_SERVICE_BOOT_SETS_SUPPORT=y
CONFIG_SERVICE_BOOT_DDR_TARGET_ADDR=0xA0000000
# CONFIG_SERVICE_BOOT_USE_PAYLOAD is not set
# CONFIG_SERVICE_BOOT_CUSTOM_FLOW is not set
CONFIG_SERVICE_BOOT_MMC_USE_GPT=y
# end of Boot Service

CONFIG_SERVICE_DDR=y
CONFIG_SERVICE_GOTO=y
CONFIG_SERVICE_CRYPTO=y
# CONFIG_SERVICE_FLASHFREEZE is not set
# CONFIG_SERVICE_POWERMODE is not set
CONFIG_SERVICE_MMC=y

#
# MMC Mode
#
CONFIG_SERVICE_MMC_MODE_EMMC=y
# CONFIG_SERVICE_MMC_MODE_SDCARD is not set
# end of MMC Mode

#
# MMC Voltage
#
# CONFIG_SERVICE_MMC_BUS_VOLTAGE_1V8 is not set
CONFIG_SERVICE_MMC_BUS_VOLTAGE_3V3=y
# end of MMC Voltage

#
# SDIO Control
#
# end of SDIO Control

CONFIG_SERVICE_QSPI=y
CONFIG_SERVICE_QSPI_COPY_TO_DDR=y
# CONFIG_SERVICE_QSPI_USE_XIP is not set
# CONFIG_SERVICE_QSPI_USE_XIP is not set
# CONFIG_W25N01GV is not set
CONFIG_S25FL512S=y
# CONFIG_MT15Q  is not set
# CONFIG_SERVICE_SGDMA is not set
CONFIG_SERVICE_SPI=y
# CONFIG_SERVICE_UART is not set
CONFIG_SERVICE_WDOG=y

#
# Watchdog Service
#
# CONFIG_SERVICE_WDOG_DEBUG is not set
CONFIG_SERVICE_WDOG_DEBUG_TIMEOUT_SEC=240
CONFIG_SERVICE_WDOG_ENABLE_E51=y
# end of Watchdog Service

# CONFIG_SERVICE_IPI_POLL is not set
CONFIG_SERVICE_OPENSBI=y
CONFIG_SERVICE_YMODEM=y
CONFIG_SERVICE_USBDMSC=y

#
# USB Device Mass Storage Class
#
# CONFIG_SERVICE_USBDMSC_REGISTER is not set
# end of USB Device Mass Storage Class

CONFIG_SERVICE_TINYCLI=y

#
# Tiny Command Line Interface
#
CONFIG_SERVICE_TINYCLI_TIMEOUT=5
# CONFIG_SERVICE_TINYCLI_REGISTER is not set
# end of Tiny Command Line Interface
# end of Services

#
# Compression
#
CONFIG_COMPRESSION=y
CONFIG_COMPRESSION_FASTLZ=y
# end of Compression

#
# General Configuration Options
#
CONFIG_OPENSBI=y

#
# OpenSBI
#
# CONFIG_PROVIDE_DTB is not set
# end of OpenSBI

# CONFIG_SUPERLOOP_IN_U_MODE is not set

#
# Memory Options
#
# CONFIG_MEMTEST is not set
CONFIG_IPI_MAX_NUM_QUEUE_MESSAGES=128
CONFIG_IPI_FIXED_BASE=y
CONFIG_IPI_BASE_ADDR=0xC0000000
CONFIG_USE_PDMA=y
CONFIG_INITIALIZE_MEMORIES=y
CONFIG_USE_PCIE=y
# end of Memory Options
# end of General Configuration Options

#
# Build Options
#
# CONFIG_COLOR_OUTPUT is not set
# CONFIG_USE_LOGO is not set

#
# Logo
#
# end of Logo

CONFIG_CC_STACKPROTECTOR_STRONG=y
# CONFIG_CC_DUMP_STACKSIZE is not set
# CONFIG_LD_RELAX is not set
CONFIG_CC_USE_MAKEDEP=y
CONFIG_CC_USE_GNU_BUILD_ID=y
CONFIG_CC_HAS_INTTYPES=y
CONFIG_DISPLAY_TOOL_VERSIONS=y
# end of Build Options

#
# Debug Options
#
CONFIG_DEBUG_LOG_STATE_TRANSITIONS=y
# CONFIG_DEBUG_LOOP_TIMES is not set
# CONFIG_DEBUG_IPI_STATS is not set
# CONFIG_DEBUG_CHUNK_DOWNLOADS is not set
# CONFIG_DEBUG_MSCGEN_IPI is not set
# end of Debug Options
```
